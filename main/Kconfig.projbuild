## main/Kconfig.projbuild
```kconfig
menu "FunkBridge Configuration"

    config FUNKBRIDGE_WIFI_DEFAULT_MODE
        int "WiFi default mode (0=BLE, 1=AP, 2=Station)"
        default 0
        range 0 2
        help
            Default transport mode on boot.
            0 = BLE (Bluetooth Low Energy)
            1 = WiFi AP (creates FunkBridge network)
            2 = WiFi Station (joins existing network)

endmenu
```
